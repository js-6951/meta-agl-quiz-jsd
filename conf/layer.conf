## conf/layer.conf
```bitbake
# We have a conf and classes directory, add to BBPATH
BBPATH .= ":${LAYERDIR}"

# We have recipes-* directories, add to BBFILES
BBFILES += "${LAYERDIR}/recipes-*/*/*.bb \
            ${LAYERDIR}/recipes-*/*/*.bbappend"

BBFILE_COLLECTIONS += "meta-agl-quiz-jsd"
BBFILE_PATTERN_meta-agl-quiz-jsd = "^${LAYERDIR}/"
BBFILE_PRIORITY_meta-agl-quiz-jsd = "6"

LAYERDEPENDS_meta-agl-quiz-jsd = "core"
LAYERSERIES_COMPAT_meta-agl-quiz-jsd = "kirkstone"
```
